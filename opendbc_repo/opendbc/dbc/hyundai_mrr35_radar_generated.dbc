CM_ "AUTOGENERATED FILE, DO NOT EDIT";

CM_ "hyundai_mrr35_radar.dbc starts here";

VERSION ""

NS_ :

BS_:

BU_: XXX

BO_ 933 RADAR_TRACK_3a5: 24 RADAR
 SG_ CHECKSUM : 0|16@1+ (1,0) [0|65535] "" XXX
 SG_ COUNTER : 16|8@1+ (1,0) [0|255] "" XXX
 SG_ NEW_SIGNAL_1 : 25|2@0+ (1,0) [0|3] "" XXX
 SG_ NEW_SIGNAL_3 : 28|2@0+ (1,0) [0|3] "" XXX
 SG_ COUNTER_3 : 31|2@0+ (1,0) [0|3] "" XXX
 SG_ NEW_SIGNAL_2 : 38|7@0- (1,0) [0|127] "" XXX
 SG_ COUNTER_256 : 47|8@0+ (1,0) [0|255] "" XXX
 SG_ NEW_SIGNAL_6 : 51|4@0+ (1,0) [0|15] "" XXX
 SG_ STATE : 54|3@0+ (1,0) [0|7] "" XXX
 SG_ NEW_SIGNAL_8 : 62|7@0- (1,0) [0|127] "" XXX
 SG_ LONG_DIST : 63|12@1+ (0.05,0) [0|8191] "m" XXX
 SG_ LAT_DIST : 76|12@1- (0.05,0) [0|127] "" XXX
 SG_ REL_SPEED : 88|14@1- (0.01,0) [0|16383] "" XXX
 SG_ NEW_SIGNAL_4 : 103|2@0+ (1,0) [0|3] "" XXX
 SG_ LAT_DIST_ACCEL : 104|13@1- (1,0) [0|8191] "" XXX
 SG_ REL_ACCEL : 118|10@1- (0.02,0) [0|1023] "" XXX
 SG_ NEW_SIGNAL_18 : 129|2@0+ (1,0) [0|3] "" XXX
 SG_ NEW_SIGNAL_5 : 133|4@0+ (1,0) [0|15] "" XXX
 SG_ NEW_SIGNAL_10 : 138|5@1+ (1,0) [0|31] "" XXX
 SG_ NEW_SIGNAL_11 : 149|6@0+ (1,0) [0|63] "" XXX
 SG_ NEW_SIGNAL_7 : 152|10@1+ (1,0) [0|1023] "" XXX
 SG_ NEW_SIGNAL_9 : 162|9@1- (1,0) [0|511] "" XXX
 SG_ NEW_SIGNAL_13 : 175|4@0+ (1,0) [0|15] "" XXX
 SG_ NEW_SIGNAL_12 : 179|4@0+ (1,0) [0|15] "" XXX
 SG_ NEW_SIGNAL_14 : 181|2@0+ (1,0) [0|3] "" XXX
 SG_ NEW_SIGNAL_15 : 183|2@0+ (1,0) [0|3] "" XXX
 SG_ NEW_SIGNAL_16 : 185|2@0+ (1,0) [0|3] "" XXX
 SG_ NEW_SIGNAL_17 : 187|2@0+ (1,0) [0|3] "" XXX

BO_ 934 RADAR_TRACK_3a6: 24 RADAR
 SG_ CHECKSUM : 0|16@1+ (1,0) [0|65535] "" XXX
 SG_ COUNTER : 16|8@1+ (1,0) [0|255] "" XXX
 SG_ NEW_SIGNAL_1 : 25|2@0+ (1,0) [0|3] "" XXX
 SG_ NEW_SIGNAL_3 : 28|2@0+ (1,0) [0|3] "" XXX
 SG_ COUNTER_3 : 31|2@0+ (1,0) [0|3] "" XXX
 SG_ NEW_SIGNAL_2 : 38|7@0- (1,0) [0|127] "" XXX
 SG_ COUNTER_256 : 47|8@0+ (1,0) [0|255] "" XXX
 SG_ NEW_SIGNAL_6 : 51|4@0+ (1,0) [0|15] "" XXX
 SG_ STATE : 54|3@0+ (1,0) [0|7] "" XXX
 SG_ NEW_SIGNAL_8 : 62|7@0- (1,0) [0|127] "" XXX
 SG_ LONG_DIST : 63|12@1+ (0.05,0) [0|8191] "m" XXX
 SG_ LAT_DIST : 76|12@1- (0.05,0) [0|127] "" XXX
 SG_ REL_SPEED : 88|14@1- (0.01,0) [0|16383] "" XXX
 SG_ NEW_SIGNAL_4 : 103|2@0+ (1,0) [0|3] "" XXX
 SG_ LAT_DIST_ACCEL : 104|13@1- (1,0) [0|8191] "" XXX
 SG_ REL_ACCEL : 118|10@1- (0.02,0) [0|1023] "" XXX
 SG_ NEW_SIGNAL_18 : 129|2@0+ (1,0) [0|3] "" XXX
 SG_ NEW_SIGNAL_5 : 133|4@0+ (1,0) [0|15] "" XXX
 SG_ NEW_SIGNAL_10 : 138|5@1+ (1,0) [0|31] "" XXX
 SG_ NEW_SIGNAL_11 : 149|6@0+ (1,0) [0|63] "" XXX
 SG_ NEW_SIGNAL_7 : 152|10@1+ (1,0) [0|1023] "" XXX
 SG_ NEW_SIGNAL_9 : 162|9@1- (1,0) [0|511] "" XXX
 SG_ NEW_SIGNAL_13 : 175|4@0+ (1,0) [0|15] "" XXX
 SG_ NEW_SIGNAL_12 : 179|4@0+ (1,0) [0|15] "" XXX
 SG_ NEW_SIGNAL_14 : 181|2@0+ (1,0) [0|3] "" XXX
 SG_ NEW_SIGNAL_15 : 183|2@0+ (1,0) [0|3] "" XXX
 SG_ NEW_SIGNAL_16 : 185|2@0+ (1,0) [0|3] "" XXX
 SG_ NEW_SIGNAL_17 : 187|2@0+ (1,0) [0|3] "" XXX

BO_ 935 RADAR_TRACK_3a7: 24 RADAR
 SG_ CHECKSUM : 0|16@1+ (1,0) [0|65535] "" XXX
 SG_ COUNTER : 16|8@1+ (1,0) [0|255] "" XXX
 SG_ NEW_SIGNAL_1 : 25|2@0+ (1,0) [0|3] "" XXX
 SG_ NEW_SIGNAL_3 : 28|2@0+ (1,0) [0|3] "" XXX
 SG_ COUNTER_3 : 31|2@0+ (1,0) [0|3] "" XXX
 SG_ NEW_SIGNAL_2 : 38|7@0- (1,0) [0|127] "" XXX
 SG_ COUNTER_256 : 47|8@0+ (1,0) [0|255] "" XXX
 SG_ NEW_SIGNAL_6 : 51|4@0+ (1,0) [0|15] "" XXX
 SG_ STATE : 54|3@0+ (1,0) [0|7] "" XXX
 SG_ NEW_SIGNAL_8 : 62|7@0- (1,0) [0|127] "" XXX
 SG_ LONG_DIST : 63|12@1+ (0.05,0) [0|8191] "m" XXX
 SG_ LAT_DIST : 76|12@1- (0.05,0) [0|127] "" XXX
 SG_ REL_SPEED : 88|14@1- (0.01,0) [0|16383] "" XXX
 SG_ NEW_SIGNAL_4 : 103|2@0+ (1,0) [0|3] "" XXX
 SG_ LAT_DIST_ACCEL : 104|13@1- (1,0) [0|8191] "" XXX
 SG_ REL_ACCEL : 118|10@1- (0.02,0) [0|1023] "" XXX
 SG_ NEW_SIGNAL_18 : 129|2@0+ (1,0) [0|3] "" XXX
 SG_ NEW_SIGNAL_5 : 133|4@0+ (1,0) [0|15] "" XXX
 SG_ NEW_SIGNAL_10 : 138|5@1+ (1,0) [0|31] "" XXX
 SG_ NEW_SIGNAL_11 : 149|6@0+ (1,0) [0|63] "" XXX
 SG_ NEW_SIGNAL_7 : 152|10@1+ (1,0) [0|1023] "" XXX
 SG_ NEW_SIGNAL_9 : 162|9@1- (1,0) [0|511] "" XXX
 SG_ NEW_SIGNAL_13 : 175|4@0+ (1,0) [0|15] "" XXX
 SG_ NEW_SIGNAL_12 : 179|4@0+ (1,0) [0|15] "" XXX
 SG_ NEW_SIGNAL_14 : 181|2@0+ (1,0) [0|3] "" XXX
 SG_ NEW_SIGNAL_15 : 183|2@0+ (1,0) [0|3] "" XXX
 SG_ NEW_SIGNAL_16 : 185|2@0+ (1,0) [0|3] "" XXX
 SG_ NEW_SIGNAL_17 : 187|2@0+ (1,0) [0|3] "" XXX

BO_ 936 RADAR_TRACK_3a8: 24 RADAR
 SG_ CHECKSUM : 0|16@1+ (1,0) [0|65535] "" XXX
 SG_ COUNTER : 16|8@1+ (1,0) [0|255] "" XXX
 SG_ NEW_SIGNAL_1 : 25|2@0+ (1,0) [0|3] "" XXX
 SG_ NEW_SIGNAL_3 : 28|2@0+ (1,0) [0|3] "" XXX
 SG_ COUNTER_3 : 31|2@0+ (1,0) [0|3] "" XXX
 SG_ NEW_SIGNAL_2 : 38|7@0- (1,0) [0|127] "" XXX
 SG_ COUNTER_256 : 47|8@0+ (1,0) [0|255] "" XXX
 SG_ NEW_SIGNAL_6 : 51|4@0+ (1,0) [0|15] "" XXX
 SG_ STATE : 54|3@0+ (1,0) [0|7] "" XXX
 SG_ NEW_SIGNAL_8 : 62|7@0- (1,0) [0|127] "" XXX
 SG_ LONG_DIST : 63|12@1+ (0.05,0) [0|8191] "m" XXX
 SG_ LAT_DIST : 76|12@1- (0.05,0) [0|127] "" XXX
 SG_ REL_SPEED : 88|14@1- (0.01,0) [0|16383] "" XXX
 SG_ NEW_SIGNAL_4 : 103|2@0+ (1,0) [0|3] "" XXX
 SG_ LAT_DIST_ACCEL : 104|13@1- (1,0) [0|8191] "" XXX
 SG_ REL_ACCEL : 118|10@1- (0.02,0) [0|1023] "" XXX
 SG_ NEW_SIGNAL_18 : 129|2@0+ (1,0) [0|3] "" XXX
 SG_ NEW_SIGNAL_5 : 133|4@0+ (1,0) [0|15] "" XXX
 SG_ NEW_SIGNAL_10 : 138|5@1+ (1,0) [0|31] "" XXX
 SG_ NEW_SIGNAL_11 : 149|6@0+ (1,0) [0|63] "" XXX
 SG_ NEW_SIGNAL_7 : 152|10@1+ (1,0) [0|1023] "" XXX
 SG_ NEW_SIGNAL_9 : 162|9@1- (1,0) [0|511] "" XXX
 SG_ NEW_SIGNAL_13 : 175|4@0+ (1,0) [0|15] "" XXX
 SG_ NEW_SIGNAL_12 : 179|4@0+ (1,0) [0|15] "" XXX
 SG_ NEW_SIGNAL_14 : 181|2@0+ (1,0) [0|3] "" XXX
 SG_ NEW_SIGNAL_15 : 183|2@0+ (1,0) [0|3] "" XXX
 SG_ NEW_SIGNAL_16 : 185|2@0+ (1,0) [0|3] "" XXX
 SG_ NEW_SIGNAL_17 : 187|2@0+ (1,0) [0|3] "" XXX

BO_ 937 RADAR_TRACK_3a9: 24 RADAR
 SG_ CHECKSUM : 0|16@1+ (1,0) [0|65535] "" XXX
 SG_ COUNTER : 16|8@1+ (1,0) [0|255] "" XXX
 SG_ NEW_SIGNAL_1 : 25|2@0+ (1,0) [0|3] "" XXX
 SG_ NEW_SIGNAL_3 : 28|2@0+ (1,0) [0|3] "" XXX
 SG_ COUNTER_3 : 31|2@0+ (1,0) [0|3] "" XXX
 SG_ NEW_SIGNAL_2 : 38|7@0- (1,0) [0|127] "" XXX
 SG_ COUNTER_256 : 47|8@0+ (1,0) [0|255] "" XXX
 SG_ NEW_SIGNAL_6 : 51|4@0+ (1,0) [0|15] "" XXX
 SG_ STATE : 54|3@0+ (1,0) [0|7] "" XXX
 SG_ NEW_SIGNAL_8 : 62|7@0- (1,0) [0|127] "" XXX
 SG_ LONG_DIST : 63|12@1+ (0.05,0) [0|8191] "m" XXX
 SG_ LAT_DIST : 76|12@1- (0.05,0) [0|127] "" XXX
 SG_ REL_SPEED : 88|14@1- (0.01,0) [0|16383] "" XXX
 SG_ NEW_SIGNAL_4 : 103|2@0+ (1,0) [0|3] "" XXX
 SG_ LAT_DIST_ACCEL : 104|13@1- (1,0) [0|8191] "" XXX
 SG_ REL_ACCEL : 118|10@1- (0.02,0) [0|1023] "" XXX
 SG_ NEW_SIGNAL_18 : 129|2@0+ (1,0) [0|3] "" XXX
 SG_ NEW_SIGNAL_5 : 133|4@0+ (1,0) [0|15] "" XXX
 SG_ NEW_SIGNAL_10 : 138|5@1+ (1,0) [0|31] "" XXX
 SG_ NEW_SIGNAL_11 : 149|6@0+ (1,0) [0|63] "" XXX
 SG_ NEW_SIGNAL_7 : 152|10@1+ (1,0) [0|1023] "" XXX
 SG_ NEW_SIGNAL_9 : 162|9@1- (1,0) [0|511] "" XXX
 SG_ NEW_SIGNAL_13 : 175|4@0+ (1,0) [0|15] "" XXX
 SG_ NEW_SIGNAL_12 : 179|4@0+ (1,0) [0|15] "" XXX
 SG_ NEW_SIGNAL_14 : 181|2@0+ (1,0) [0|3] "" XXX
 SG_ NEW_SIGNAL_15 : 183|2@0+ (1,0) [0|3] "" XXX
 SG_ NEW_SIGNAL_16 : 185|2@0+ (1,0) [0|3] "" XXX
 SG_ NEW_SIGNAL_17 : 187|2@0+ (1,0) [0|3] "" XXX

BO_ 938 RADAR_TRACK_3aa: 24 RADAR
 SG_ CHECKSUM : 0|16@1+ (1,0) [0|65535] "" XXX
 SG_ COUNTER : 16|8@1+ (1,0) [0|255] "" XXX
 SG_ NEW_SIGNAL_1 : 25|2@0+ (1,0) [0|3] "" XXX
 SG_ NEW_SIGNAL_3 : 28|2@0+ (1,0) [0|3] "" XXX
 SG_ COUNTER_3 : 31|2@0+ (1,0) [0|3] "" XXX
 SG_ NEW_SIGNAL_2 : 38|7@0- (1,0) [0|127] "" XXX
 SG_ COUNTER_256 : 47|8@0+ (1,0) [0|255] "" XXX
 SG_ NEW_SIGNAL_6 : 51|4@0+ (1,0) [0|15] "" XXX
 SG_ STATE : 54|3@0+ (1,0) [0|7] "" XXX
 SG_ NEW_SIGNAL_8 : 62|7@0- (1,0) [0|127] "" XXX
 SG_ LONG_DIST : 63|12@1+ (0.05,0) [0|8191] "m" XXX
 SG_ LAT_DIST : 76|12@1- (0.05,0) [0|127] "" XXX
 SG_ REL_SPEED : 88|14@1- (0.01,0) [0|16383] "" XXX
 SG_ NEW_SIGNAL_4 : 103|2@0+ (1,0) [0|3] "" XXX
 SG_ LAT_DIST_ACCEL : 104|13@1- (1,0) [0|8191] "" XXX
 SG_ REL_ACCEL : 118|10@1- (0.02,0) [0|1023] "" XXX
 SG_ NEW_SIGNAL_18 : 129|2@0+ (1,0) [0|3] "" XXX
 SG_ NEW_SIGNAL_5 : 133|4@0+ (1,0) [0|15] "" XXX
 SG_ NEW_SIGNAL_10 : 138|5@1+ (1,0) [0|31] "" XXX
 SG_ NEW_SIGNAL_11 : 149|6@0+ (1,0) [0|63] "" XXX
 SG_ NEW_SIGNAL_7 : 152|10@1+ (1,0) [0|1023] "" XXX
 SG_ NEW_SIGNAL_9 : 162|9@1- (1,0) [0|511] "" XXX
 SG_ NEW_SIGNAL_13 : 175|4@0+ (1,0) [0|15] "" XXX
 SG_ NEW_SIGNAL_12 : 179|4@0+ (1,0) [0|15] "" XXX
 SG_ NEW_SIGNAL_14 : 181|2@0+ (1,0) [0|3] "" XXX
 SG_ NEW_SIGNAL_15 : 183|2@0+ (1,0) [0|3] "" XXX
 SG_ NEW_SIGNAL_16 : 185|2@0+ (1,0) [0|3] "" XXX
 SG_ NEW_SIGNAL_17 : 187|2@0+ (1,0) [0|3] "" XXX

BO_ 939 RADAR_TRACK_3ab: 24 RADAR
 SG_ CHECKSUM : 0|16@1+ (1,0) [0|65535] "" XXX
 SG_ COUNTER : 16|8@1+ (1,0) [0|255] "" XXX
 SG_ NEW_SIGNAL_1 : 25|2@0+ (1,0) [0|3] "" XXX
 SG_ NEW_SIGNAL_3 : 28|2@0+ (1,0) [0|3] "" XXX
 SG_ COUNTER_3 : 31|2@0+ (1,0) [0|3] "" XXX
 SG_ NEW_SIGNAL_2 : 38|7@0- (1,0) [0|127] "" XXX
 SG_ COUNTER_256 : 47|8@0+ (1,0) [0|255] "" XXX
 SG_ NEW_SIGNAL_6 : 51|4@0+ (1,0) [0|15] "" XXX
 SG_ STATE : 54|3@0+ (1,0) [0|7] "" XXX
 SG_ NEW_SIGNAL_8 : 62|7@0- (1,0) [0|127] "" XXX
 SG_ LONG_DIST : 63|12@1+ (0.05,0) [0|8191] "m" XXX
 SG_ LAT_DIST : 76|12@1- (0.05,0) [0|127] "" XXX
 SG_ REL_SPEED : 88|14@1- (0.01,0) [0|16383] "" XXX
 SG_ NEW_SIGNAL_4 : 103|2@0+ (1,0) [0|3] "" XXX
 SG_ LAT_DIST_ACCEL : 104|13@1- (1,0) [0|8191] "" XXX
 SG_ REL_ACCEL : 118|10@1- (0.02,0) [0|1023] "" XXX
 SG_ NEW_SIGNAL_18 : 129|2@0+ (1,0) [0|3] "" XXX
 SG_ NEW_SIGNAL_5 : 133|4@0+ (1,0) [0|15] "" XXX
 SG_ NEW_SIGNAL_10 : 138|5@1+ (1,0) [0|31] "" XXX
 SG_ NEW_SIGNAL_11 : 149|6@0+ (1,0) [0|63] "" XXX
 SG_ NEW_SIGNAL_7 : 152|10@1+ (1,0) [0|1023] "" XXX
 SG_ NEW_SIGNAL_9 : 162|9@1- (1,0) [0|511] "" XXX
 SG_ NEW_SIGNAL_13 : 175|4@0+ (1,0) [0|15] "" XXX
 SG_ NEW_SIGNAL_12 : 179|4@0+ (1,0) [0|15] "" XXX
 SG_ NEW_SIGNAL_14 : 181|2@0+ (1,0) [0|3] "" XXX
 SG_ NEW_SIGNAL_15 : 183|2@0+ (1,0) [0|3] "" XXX
 SG_ NEW_SIGNAL_16 : 185|2@0+ (1,0) [0|3] "" XXX
 SG_ NEW_SIGNAL_17 : 187|2@0+ (1,0) [0|3] "" XXX

BO_ 940 RADAR_TRACK_3ac: 24 RADAR
 SG_ CHECKSUM : 0|16@1+ (1,0) [0|65535] "" XXX
 SG_ COUNTER : 16|8@1+ (1,0) [0|255] "" XXX
 SG_ NEW_SIGNAL_1 : 25|2@0+ (1,0) [0|3] "" XXX
 SG_ NEW_SIGNAL_3 : 28|2@0+ (1,0) [0|3] "" XXX
 SG_ COUNTER_3 : 31|2@0+ (1,0) [0|3] "" XXX
 SG_ NEW_SIGNAL_2 : 38|7@0- (1,0) [0|127] "" XXX
 SG_ COUNTER_256 : 47|8@0+ (1,0) [0|255] "" XXX
 SG_ NEW_SIGNAL_6 : 51|4@0+ (1,0) [0|15] "" XXX
 SG_ STATE : 54|3@0+ (1,0) [0|7] "" XXX
 SG_ NEW_SIGNAL_8 : 62|7@0- (1,0) [0|127] "" XXX
 SG_ LONG_DIST : 63|12@1+ (0.05,0) [0|8191] "m" XXX
 SG_ LAT_DIST : 76|12@1- (0.05,0) [0|127] "" XXX
 SG_ REL_SPEED : 88|14@1- (0.01,0) [0|16383] "" XXX
 SG_ NEW_SIGNAL_4 : 103|2@0+ (1,0) [0|3] "" XXX
 SG_ LAT_DIST_ACCEL : 104|13@1- (1,0) [0|8191] "" XXX
 SG_ REL_ACCEL : 118|10@1- (0.02,0) [0|1023] "" XXX
 SG_ NEW_SIGNAL_18 : 129|2@0+ (1,0) [0|3] "" XXX
 SG_ NEW_SIGNAL_5 : 133|4@0+ (1,0) [0|15] "" XXX
 SG_ NEW_SIGNAL_10 : 138|5@1+ (1,0) [0|31] "" XXX
 SG_ NEW_SIGNAL_11 : 149|6@0+ (1,0) [0|63] "" XXX
 SG_ NEW_SIGNAL_7 : 152|10@1+ (1,0) [0|1023] "" XXX
 SG_ NEW_SIGNAL_9 : 162|9@1- (1,0) [0|511] "" XXX
 SG_ NEW_SIGNAL_13 : 175|4@0+ (1,0) [0|15] "" XXX
 SG_ NEW_SIGNAL_12 : 179|4@0+ (1,0) [0|15] "" XXX
 SG_ NEW_SIGNAL_14 : 181|2@0+ (1,0) [0|3] "" XXX
 SG_ NEW_SIGNAL_15 : 183|2@0+ (1,0) [0|3] "" XXX
 SG_ NEW_SIGNAL_16 : 185|2@0+ (1,0) [0|3] "" XXX
 SG_ NEW_SIGNAL_17 : 187|2@0+ (1,0) [0|3] "" XXX

BO_ 941 RADAR_TRACK_3ad: 24 RADAR
 SG_ CHECKSUM : 0|16@1+ (1,0) [0|65535] "" XXX
 SG_ COUNTER : 16|8@1+ (1,0) [0|255] "" XXX
 SG_ NEW_SIGNAL_1 : 25|2@0+ (1,0) [0|3] "" XXX
 SG_ NEW_SIGNAL_3 : 28|2@0+ (1,0) [0|3] "" XXX
 SG_ COUNTER_3 : 31|2@0+ (1,0) [0|3] "" XXX
 SG_ NEW_SIGNAL_2 : 38|7@0- (1,0) [0|127] "" XXX
 SG_ COUNTER_256 : 47|8@0+ (1,0) [0|255] "" XXX
 SG_ NEW_SIGNAL_6 : 51|4@0+ (1,0) [0|15] "" XXX
 SG_ STATE : 54|3@0+ (1,0) [0|7] "" XXX
 SG_ NEW_SIGNAL_8 : 62|7@0- (1,0) [0|127] "" XXX
 SG_ LONG_DIST : 63|12@1+ (0.05,0) [0|8191] "m" XXX
 SG_ LAT_DIST : 76|12@1- (0.05,0) [0|127] "" XXX
 SG_ REL_SPEED : 88|14@1- (0.01,0) [0|16383] "" XXX
 SG_ NEW_SIGNAL_4 : 103|2@0+ (1,0) [0|3] "" XXX
 SG_ LAT_DIST_ACCEL : 104|13@1- (1,0) [0|8191] "" XXX
 SG_ REL_ACCEL : 118|10@1- (0.02,0) [0|1023] "" XXX
 SG_ NEW_SIGNAL_18 : 129|2@0+ (1,0) [0|3] "" XXX
 SG_ NEW_SIGNAL_5 : 133|4@0+ (1,0) [0|15] "" XXX
 SG_ NEW_SIGNAL_10 : 138|5@1+ (1,0) [0|31] "" XXX
 SG_ NEW_SIGNAL_11 : 149|6@0+ (1,0) [0|63] "" XXX
 SG_ NEW_SIGNAL_7 : 152|10@1+ (1,0) [0|1023] "" XXX
 SG_ NEW_SIGNAL_9 : 162|9@1- (1,0) [0|511] "" XXX
 SG_ NEW_SIGNAL_13 : 175|4@0+ (1,0) [0|15] "" XXX
 SG_ NEW_SIGNAL_12 : 179|4@0+ (1,0) [0|15] "" XXX
 SG_ NEW_SIGNAL_14 : 181|2@0+ (1,0) [0|3] "" XXX
 SG_ NEW_SIGNAL_15 : 183|2@0+ (1,0) [0|3] "" XXX
 SG_ NEW_SIGNAL_16 : 185|2@0+ (1,0) [0|3] "" XXX
 SG_ NEW_SIGNAL_17 : 187|2@0+ (1,0) [0|3] "" XXX

BO_ 942 RADAR_TRACK_3ae: 24 RADAR
 SG_ CHECKSUM : 0|16@1+ (1,0) [0|65535] "" XXX
 SG_ COUNTER : 16|8@1+ (1,0) [0|255] "" XXX
 SG_ NEW_SIGNAL_1 : 25|2@0+ (1,0) [0|3] "" XXX
 SG_ NEW_SIGNAL_3 : 28|2@0+ (1,0) [0|3] "" XXX
 SG_ COUNTER_3 : 31|2@0+ (1,0) [0|3] "" XXX
 SG_ NEW_SIGNAL_2 : 38|7@0- (1,0) [0|127] "" XXX
 SG_ COUNTER_256 : 47|8@0+ (1,0) [0|255] "" XXX
 SG_ NEW_SIGNAL_6 : 51|4@0+ (1,0) [0|15] "" XXX
 SG_ STATE : 54|3@0+ (1,0) [0|7] "" XXX
 SG_ NEW_SIGNAL_8 : 62|7@0- (1,0) [0|127] "" XXX
 SG_ LONG_DIST : 63|12@1+ (0.05,0) [0|8191] "m" XXX
 SG_ LAT_DIST : 76|12@1- (0.05,0) [0|127] "" XXX
 SG_ REL_SPEED : 88|14@1- (0.01,0) [0|16383] "" XXX
 SG_ NEW_SIGNAL_4 : 103|2@0+ (1,0) [0|3] "" XXX
 SG_ LAT_DIST_ACCEL : 104|13@1- (1,0) [0|8191] "" XXX
 SG_ REL_ACCEL : 118|10@1- (0.02,0) [0|1023] "" XXX
 SG_ NEW_SIGNAL_18 : 129|2@0+ (1,0) [0|3] "" XXX
 SG_ NEW_SIGNAL_5 : 133|4@0+ (1,0) [0|15] "" XXX
 SG_ NEW_SIGNAL_10 : 138|5@1+ (1,0) [0|31] "" XXX
 SG_ NEW_SIGNAL_11 : 149|6@0+ (1,0) [0|63] "" XXX
 SG_ NEW_SIGNAL_7 : 152|10@1+ (1,0) [0|1023] "" XXX
 SG_ NEW_SIGNAL_9 : 162|9@1- (1,0) [0|511] "" XXX
 SG_ NEW_SIGNAL_13 : 175|4@0+ (1,0) [0|15] "" XXX
 SG_ NEW_SIGNAL_12 : 179|4@0+ (1,0) [0|15] "" XXX
 SG_ NEW_SIGNAL_14 : 181|2@0+ (1,0) [0|3] "" XXX
 SG_ NEW_SIGNAL_15 : 183|2@0+ (1,0) [0|3] "" XXX
 SG_ NEW_SIGNAL_16 : 185|2@0+ (1,0) [0|3] "" XXX
 SG_ NEW_SIGNAL_17 : 187|2@0+ (1,0) [0|3] "" XXX

BO_ 943 RADAR_TRACK_3af: 24 RADAR
 SG_ CHECKSUM : 0|16@1+ (1,0) [0|65535] "" XXX
 SG_ COUNTER : 16|8@1+ (1,0) [0|255] "" XXX
 SG_ NEW_SIGNAL_1 : 25|2@0+ (1,0) [0|3] "" XXX
 SG_ NEW_SIGNAL_3 : 28|2@0+ (1,0) [0|3] "" XXX
 SG_ COUNTER_3 : 31|2@0+ (1,0) [0|3] "" XXX
 SG_ NEW_SIGNAL_2 : 38|7@0- (1,0) [0|127] "" XXX
 SG_ COUNTER_256 : 47|8@0+ (1,0) [0|255] "" XXX
 SG_ NEW_SIGNAL_6 : 51|4@0+ (1,0) [0|15] "" XXX
 SG_ STATE : 54|3@0+ (1,0) [0|7] "" XXX
 SG_ NEW_SIGNAL_8 : 62|7@0- (1,0) [0|127] "" XXX
 SG_ LONG_DIST : 63|12@1+ (0.05,0) [0|8191] "m" XXX
 SG_ LAT_DIST : 76|12@1- (0.05,0) [0|127] "" XXX
 SG_ REL_SPEED : 88|14@1- (0.01,0) [0|16383] "" XXX
 SG_ NEW_SIGNAL_4 : 103|2@0+ (1,0) [0|3] "" XXX
 SG_ LAT_DIST_ACCEL : 104|13@1- (1,0) [0|8191] "" XXX
 SG_ REL_ACCEL : 118|10@1- (0.02,0) [0|1023] "" XXX
 SG_ NEW_SIGNAL_18 : 129|2@0+ (1,0) [0|3] "" XXX
 SG_ NEW_SIGNAL_5 : 133|4@0+ (1,0) [0|15] "" XXX
 SG_ NEW_SIGNAL_10 : 138|5@1+ (1,0) [0|31] "" XXX
 SG_ NEW_SIGNAL_11 : 149|6@0+ (1,0) [0|63] "" XXX
 SG_ NEW_SIGNAL_7 : 152|10@1+ (1,0) [0|1023] "" XXX
 SG_ NEW_SIGNAL_9 : 162|9@1- (1,0) [0|511] "" XXX
 SG_ NEW_SIGNAL_13 : 175|4@0+ (1,0) [0|15] "" XXX
 SG_ NEW_SIGNAL_12 : 179|4@0+ (1,0) [0|15] "" XXX
 SG_ NEW_SIGNAL_14 : 181|2@0+ (1,0) [0|3] "" XXX
 SG_ NEW_SIGNAL_15 : 183|2@0+ (1,0) [0|3] "" XXX
 SG_ NEW_SIGNAL_16 : 185|2@0+ (1,0) [0|3] "" XXX
 SG_ NEW_SIGNAL_17 : 187|2@0+ (1,0) [0|3] "" XXX

BO_ 944 RADAR_TRACK_3b0: 24 RADAR
 SG_ CHECKSUM : 0|16@1+ (1,0) [0|65535] "" XXX
 SG_ COUNTER : 16|8@1+ (1,0) [0|255] "" XXX
 SG_ NEW_SIGNAL_1 : 25|2@0+ (1,0) [0|3] "" XXX
 SG_ NEW_SIGNAL_3 : 28|2@0+ (1,0) [0|3] "" XXX
 SG_ COUNTER_3 : 31|2@0+ (1,0) [0|3] "" XXX
 SG_ NEW_SIGNAL_2 : 38|7@0- (1,0) [0|127] "" XXX
 SG_ COUNTER_256 : 47|8@0+ (1,0) [0|255] "" XXX
 SG_ NEW_SIGNAL_6 : 51|4@0+ (1,0) [0|15] "" XXX
 SG_ STATE : 54|3@0+ (1,0) [0|7] "" XXX
 SG_ NEW_SIGNAL_8 : 62|7@0- (1,0) [0|127] "" XXX
 SG_ LONG_DIST : 63|12@1+ (0.05,0) [0|8191] "m" XXX
 SG_ LAT_DIST : 76|12@1- (0.05,0) [0|127] "" XXX
 SG_ REL_SPEED : 88|14@1- (0.01,0) [0|16383] "" XXX
 SG_ NEW_SIGNAL_4 : 103|2@0+ (1,0) [0|3] "" XXX
 SG_ LAT_DIST_ACCEL : 104|13@1- (1,0) [0|8191] "" XXX
 SG_ REL_ACCEL : 118|10@1- (0.02,0) [0|1023] "" XXX
 SG_ NEW_SIGNAL_18 : 129|2@0+ (1,0) [0|3] "" XXX
 SG_ NEW_SIGNAL_5 : 133|4@0+ (1,0) [0|15] "" XXX
 SG_ NEW_SIGNAL_10 : 138|5@1+ (1,0) [0|31] "" XXX
 SG_ NEW_SIGNAL_11 : 149|6@0+ (1,0) [0|63] "" XXX
 SG_ NEW_SIGNAL_7 : 152|10@1+ (1,0) [0|1023] "" XXX
 SG_ NEW_SIGNAL_9 : 162|9@1- (1,0) [0|511] "" XXX
 SG_ NEW_SIGNAL_13 : 175|4@0+ (1,0) [0|15] "" XXX
 SG_ NEW_SIGNAL_12 : 179|4@0+ (1,0) [0|15] "" XXX
 SG_ NEW_SIGNAL_14 : 181|2@0+ (1,0) [0|3] "" XXX
 SG_ NEW_SIGNAL_15 : 183|2@0+ (1,0) [0|3] "" XXX
 SG_ NEW_SIGNAL_16 : 185|2@0+ (1,0) [0|3] "" XXX
 SG_ NEW_SIGNAL_17 : 187|2@0+ (1,0) [0|3] "" XXX

BO_ 945 RADAR_TRACK_3b1: 24 RADAR
 SG_ CHECKSUM : 0|16@1+ (1,0) [0|65535] "" XXX
 SG_ COUNTER : 16|8@1+ (1,0) [0|255] "" XXX
 SG_ NEW_SIGNAL_1 : 25|2@0+ (1,0) [0|3] "" XXX
 SG_ NEW_SIGNAL_3 : 28|2@0+ (1,0) [0|3] "" XXX
 SG_ COUNTER_3 : 31|2@0+ (1,0) [0|3] "" XXX
 SG_ NEW_SIGNAL_2 : 38|7@0- (1,0) [0|127] "" XXX
 SG_ COUNTER_256 : 47|8@0+ (1,0) [0|255] "" XXX
 SG_ NEW_SIGNAL_6 : 51|4@0+ (1,0) [0|15] "" XXX
 SG_ STATE : 54|3@0+ (1,0) [0|7] "" XXX
 SG_ NEW_SIGNAL_8 : 62|7@0- (1,0) [0|127] "" XXX
 SG_ LONG_DIST : 63|12@1+ (0.05,0) [0|8191] "m" XXX
 SG_ LAT_DIST : 76|12@1- (0.05,0) [0|127] "" XXX
 SG_ REL_SPEED : 88|14@1- (0.01,0) [0|16383] "" XXX
 SG_ NEW_SIGNAL_4 : 103|2@0+ (1,0) [0|3] "" XXX
 SG_ LAT_DIST_ACCEL : 104|13@1- (1,0) [0|8191] "" XXX
 SG_ REL_ACCEL : 118|10@1- (0.02,0) [0|1023] "" XXX
 SG_ NEW_SIGNAL_18 : 129|2@0+ (1,0) [0|3] "" XXX
 SG_ NEW_SIGNAL_5 : 133|4@0+ (1,0) [0|15] "" XXX
 SG_ NEW_SIGNAL_10 : 138|5@1+ (1,0) [0|31] "" XXX
 SG_ NEW_SIGNAL_11 : 149|6@0+ (1,0) [0|63] "" XXX
 SG_ NEW_SIGNAL_7 : 152|10@1+ (1,0) [0|1023] "" XXX
 SG_ NEW_SIGNAL_9 : 162|9@1- (1,0) [0|511] "" XXX
 SG_ NEW_SIGNAL_13 : 175|4@0+ (1,0) [0|15] "" XXX
 SG_ NEW_SIGNAL_12 : 179|4@0+ (1,0) [0|15] "" XXX
 SG_ NEW_SIGNAL_14 : 181|2@0+ (1,0) [0|3] "" XXX
 SG_ NEW_SIGNAL_15 : 183|2@0+ (1,0) [0|3] "" XXX
 SG_ NEW_SIGNAL_16 : 185|2@0+ (1,0) [0|3] "" XXX
 SG_ NEW_SIGNAL_17 : 187|2@0+ (1,0) [0|3] "" XXX

BO_ 946 RADAR_TRACK_3b2: 24 RADAR
 SG_ CHECKSUM : 0|16@1+ (1,0) [0|65535] "" XXX
 SG_ COUNTER : 16|8@1+ (1,0) [0|255] "" XXX
 SG_ NEW_SIGNAL_1 : 25|2@0+ (1,0) [0|3] "" XXX
 SG_ NEW_SIGNAL_3 : 28|2@0+ (1,0) [0|3] "" XXX
 SG_ COUNTER_3 : 31|2@0+ (1,0) [0|3] "" XXX
 SG_ NEW_SIGNAL_2 : 38|7@0- (1,0) [0|127] "" XXX
 SG_ COUNTER_256 : 47|8@0+ (1,0) [0|255] "" XXX
 SG_ NEW_SIGNAL_6 : 51|4@0+ (1,0) [0|15] "" XXX
 SG_ STATE : 54|3@0+ (1,0) [0|7] "" XXX
 SG_ NEW_SIGNAL_8 : 62|7@0- (1,0) [0|127] "" XXX
 SG_ LONG_DIST : 63|12@1+ (0.05,0) [0|8191] "m" XXX
 SG_ LAT_DIST : 76|12@1- (0.05,0) [0|127] "" XXX
 SG_ REL_SPEED : 88|14@1- (0.01,0) [0|16383] "" XXX
 SG_ NEW_SIGNAL_4 : 103|2@0+ (1,0) [0|3] "" XXX
 SG_ LAT_DIST_ACCEL : 104|13@1- (1,0) [0|8191] "" XXX
 SG_ REL_ACCEL : 118|10@1- (0.02,0) [0|1023] "" XXX
 SG_ NEW_SIGNAL_18 : 129|2@0+ (1,0) [0|3] "" XXX
 SG_ NEW_SIGNAL_5 : 133|4@0+ (1,0) [0|15] "" XXX
 SG_ NEW_SIGNAL_10 : 138|5@1+ (1,0) [0|31] "" XXX
 SG_ NEW_SIGNAL_11 : 149|6@0+ (1,0) [0|63] "" XXX
 SG_ NEW_SIGNAL_7 : 152|10@1+ (1,0) [0|1023] "" XXX
 SG_ NEW_SIGNAL_9 : 162|9@1- (1,0) [0|511] "" XXX
 SG_ NEW_SIGNAL_13 : 175|4@0+ (1,0) [0|15] "" XXX
 SG_ NEW_SIGNAL_12 : 179|4@0+ (1,0) [0|15] "" XXX
 SG_ NEW_SIGNAL_14 : 181|2@0+ (1,0) [0|3] "" XXX
 SG_ NEW_SIGNAL_15 : 183|2@0+ (1,0) [0|3] "" XXX
 SG_ NEW_SIGNAL_16 : 185|2@0+ (1,0) [0|3] "" XXX
 SG_ NEW_SIGNAL_17 : 187|2@0+ (1,0) [0|3] "" XXX

BO_ 947 RADAR_TRACK_3b3: 24 RADAR
 SG_ CHECKSUM : 0|16@1+ (1,0) [0|65535] "" XXX
 SG_ COUNTER : 16|8@1+ (1,0) [0|255] "" XXX
 SG_ NEW_SIGNAL_1 : 25|2@0+ (1,0) [0|3] "" XXX
 SG_ NEW_SIGNAL_3 : 28|2@0+ (1,0) [0|3] "" XXX
 SG_ COUNTER_3 : 31|2@0+ (1,0) [0|3] "" XXX
 SG_ NEW_SIGNAL_2 : 38|7@0- (1,0) [0|127] "" XXX
 SG_ COUNTER_256 : 47|8@0+ (1,0) [0|255] "" XXX
 SG_ NEW_SIGNAL_6 : 51|4@0+ (1,0) [0|15] "" XXX
 SG_ STATE : 54|3@0+ (1,0) [0|7] "" XXX
 SG_ NEW_SIGNAL_8 : 62|7@0- (1,0) [0|127] "" XXX
 SG_ LONG_DIST : 63|12@1+ (0.05,0) [0|8191] "m" XXX
 SG_ LAT_DIST : 76|12@1- (0.05,0) [0|127] "" XXX
 SG_ REL_SPEED : 88|14@1- (0.01,0) [0|16383] "" XXX
 SG_ NEW_SIGNAL_4 : 103|2@0+ (1,0) [0|3] "" XXX
 SG_ LAT_DIST_ACCEL : 104|13@1- (1,0) [0|8191] "" XXX
 SG_ REL_ACCEL : 118|10@1- (0.02,0) [0|1023] "" XXX
 SG_ NEW_SIGNAL_18 : 129|2@0+ (1,0) [0|3] "" XXX
 SG_ NEW_SIGNAL_5 : 133|4@0+ (1,0) [0|15] "" XXX
 SG_ NEW_SIGNAL_10 : 138|5@1+ (1,0) [0|31] "" XXX
 SG_ NEW_SIGNAL_11 : 149|6@0+ (1,0) [0|63] "" XXX
 SG_ NEW_SIGNAL_7 : 152|10@1+ (1,0) [0|1023] "" XXX
 SG_ NEW_SIGNAL_9 : 162|9@1- (1,0) [0|511] "" XXX
 SG_ NEW_SIGNAL_13 : 175|4@0+ (1,0) [0|15] "" XXX
 SG_ NEW_SIGNAL_12 : 179|4@0+ (1,0) [0|15] "" XXX
 SG_ NEW_SIGNAL_14 : 181|2@0+ (1,0) [0|3] "" XXX
 SG_ NEW_SIGNAL_15 : 183|2@0+ (1,0) [0|3] "" XXX
 SG_ NEW_SIGNAL_16 : 185|2@0+ (1,0) [0|3] "" XXX
 SG_ NEW_SIGNAL_17 : 187|2@0+ (1,0) [0|3] "" XXX

BO_ 948 RADAR_TRACK_3b4: 24 RADAR
 SG_ CHECKSUM : 0|16@1+ (1,0) [0|65535] "" XXX
 SG_ COUNTER : 16|8@1+ (1,0) [0|255] "" XXX
 SG_ NEW_SIGNAL_1 : 25|2@0+ (1,0) [0|3] "" XXX
 SG_ NEW_SIGNAL_3 : 28|2@0+ (1,0) [0|3] "" XXX
 SG_ COUNTER_3 : 31|2@0+ (1,0) [0|3] "" XXX
 SG_ NEW_SIGNAL_2 : 38|7@0- (1,0) [0|127] "" XXX
 SG_ COUNTER_256 : 47|8@0+ (1,0) [0|255] "" XXX
 SG_ NEW_SIGNAL_6 : 51|4@0+ (1,0) [0|15] "" XXX
 SG_ STATE : 54|3@0+ (1,0) [0|7] "" XXX
 SG_ NEW_SIGNAL_8 : 62|7@0- (1,0) [0|127] "" XXX
 SG_ LONG_DIST : 63|12@1+ (0.05,0) [0|8191] "m" XXX
 SG_ LAT_DIST : 76|12@1- (0.05,0) [0|127] "" XXX
 SG_ REL_SPEED : 88|14@1- (0.01,0) [0|16383] "" XXX
 SG_ NEW_SIGNAL_4 : 103|2@0+ (1,0) [0|3] "" XXX
 SG_ LAT_DIST_ACCEL : 104|13@1- (1,0) [0|8191] "" XXX
 SG_ REL_ACCEL : 118|10@1- (0.02,0) [0|1023] "" XXX
 SG_ NEW_SIGNAL_18 : 129|2@0+ (1,0) [0|3] "" XXX
 SG_ NEW_SIGNAL_5 : 133|4@0+ (1,0) [0|15] "" XXX
 SG_ NEW_SIGNAL_10 : 138|5@1+ (1,0) [0|31] "" XXX
 SG_ NEW_SIGNAL_11 : 149|6@0+ (1,0) [0|63] "" XXX
 SG_ NEW_SIGNAL_7 : 152|10@1+ (1,0) [0|1023] "" XXX
 SG_ NEW_SIGNAL_9 : 162|9@1- (1,0) [0|511] "" XXX
 SG_ NEW_SIGNAL_13 : 175|4@0+ (1,0) [0|15] "" XXX
 SG_ NEW_SIGNAL_12 : 179|4@0+ (1,0) [0|15] "" XXX
 SG_ NEW_SIGNAL_14 : 181|2@0+ (1,0) [0|3] "" XXX
 SG_ NEW_SIGNAL_15 : 183|2@0+ (1,0) [0|3] "" XXX
 SG_ NEW_SIGNAL_16 : 185|2@0+ (1,0) [0|3] "" XXX
 SG_ NEW_SIGNAL_17 : 187|2@0+ (1,0) [0|3] "" XXX

BO_ 949 RADAR_TRACK_3b5: 24 RADAR
 SG_ CHECKSUM : 0|16@1+ (1,0) [0|65535] "" XXX
 SG_ COUNTER : 16|8@1+ (1,0) [0|255] "" XXX
 SG_ NEW_SIGNAL_1 : 25|2@0+ (1,0) [0|3] "" XXX
 SG_ NEW_SIGNAL_3 : 28|2@0+ (1,0) [0|3] "" XXX
 SG_ COUNTER_3 : 31|2@0+ (1,0) [0|3] "" XXX
 SG_ NEW_SIGNAL_2 : 38|7@0- (1,0) [0|127] "" XXX
 SG_ COUNTER_256 : 47|8@0+ (1,0) [0|255] "" XXX
 SG_ NEW_SIGNAL_6 : 51|4@0+ (1,0) [0|15] "" XXX
 SG_ STATE : 54|3@0+ (1,0) [0|7] "" XXX
 SG_ NEW_SIGNAL_8 : 62|7@0- (1,0) [0|127] "" XXX
 SG_ LONG_DIST : 63|12@1+ (0.05,0) [0|8191] "m" XXX
 SG_ LAT_DIST : 76|12@1- (0.05,0) [0|127] "" XXX
 SG_ REL_SPEED : 88|14@1- (0.01,0) [0|16383] "" XXX
 SG_ NEW_SIGNAL_4 : 103|2@0+ (1,0) [0|3] "" XXX
 SG_ LAT_DIST_ACCEL : 104|13@1- (1,0) [0|8191] "" XXX
 SG_ REL_ACCEL : 118|10@1- (0.02,0) [0|1023] "" XXX
 SG_ NEW_SIGNAL_18 : 129|2@0+ (1,0) [0|3] "" XXX
 SG_ NEW_SIGNAL_5 : 133|4@0+ (1,0) [0|15] "" XXX
 SG_ NEW_SIGNAL_10 : 138|5@1+ (1,0) [0|31] "" XXX
 SG_ NEW_SIGNAL_11 : 149|6@0+ (1,0) [0|63] "" XXX
 SG_ NEW_SIGNAL_7 : 152|10@1+ (1,0) [0|1023] "" XXX
 SG_ NEW_SIGNAL_9 : 162|9@1- (1,0) [0|511] "" XXX
 SG_ NEW_SIGNAL_13 : 175|4@0+ (1,0) [0|15] "" XXX
 SG_ NEW_SIGNAL_12 : 179|4@0+ (1,0) [0|15] "" XXX
 SG_ NEW_SIGNAL_14 : 181|2@0+ (1,0) [0|3] "" XXX
 SG_ NEW_SIGNAL_15 : 183|2@0+ (1,0) [0|3] "" XXX
 SG_ NEW_SIGNAL_16 : 185|2@0+ (1,0) [0|3] "" XXX
 SG_ NEW_SIGNAL_17 : 187|2@0+ (1,0) [0|3] "" XXX

BO_ 950 RADAR_TRACK_3b6: 24 RADAR
 SG_ CHECKSUM : 0|16@1+ (1,0) [0|65535] "" XXX
 SG_ COUNTER : 16|8@1+ (1,0) [0|255] "" XXX
 SG_ NEW_SIGNAL_1 : 25|2@0+ (1,0) [0|3] "" XXX
 SG_ NEW_SIGNAL_3 : 28|2@0+ (1,0) [0|3] "" XXX
 SG_ COUNTER_3 : 31|2@0+ (1,0) [0|3] "" XXX
 SG_ NEW_SIGNAL_2 : 38|7@0- (1,0) [0|127] "" XXX
 SG_ COUNTER_256 : 47|8@0+ (1,0) [0|255] "" XXX
 SG_ NEW_SIGNAL_6 : 51|4@0+ (1,0) [0|15] "" XXX
 SG_ STATE : 54|3@0+ (1,0) [0|7] "" XXX
 SG_ NEW_SIGNAL_8 : 62|7@0- (1,0) [0|127] "" XXX
 SG_ LONG_DIST : 63|12@1+ (0.05,0) [0|8191] "m" XXX
 SG_ LAT_DIST : 76|12@1- (0.05,0) [0|127] "" XXX
 SG_ REL_SPEED : 88|14@1- (0.01,0) [0|16383] "" XXX
 SG_ NEW_SIGNAL_4 : 103|2@0+ (1,0) [0|3] "" XXX
 SG_ LAT_DIST_ACCEL : 104|13@1- (1,0) [0|8191] "" XXX
 SG_ REL_ACCEL : 118|10@1- (0.02,0) [0|1023] "" XXX
 SG_ NEW_SIGNAL_18 : 129|2@0+ (1,0) [0|3] "" XXX
 SG_ NEW_SIGNAL_5 : 133|4@0+ (1,0) [0|15] "" XXX
 SG_ NEW_SIGNAL_10 : 138|5@1+ (1,0) [0|31] "" XXX
 SG_ NEW_SIGNAL_11 : 149|6@0+ (1,0) [0|63] "" XXX
 SG_ NEW_SIGNAL_7 : 152|10@1+ (1,0) [0|1023] "" XXX
 SG_ NEW_SIGNAL_9 : 162|9@1- (1,0) [0|511] "" XXX
 SG_ NEW_SIGNAL_13 : 175|4@0+ (1,0) [0|15] "" XXX
 SG_ NEW_SIGNAL_12 : 179|4@0+ (1,0) [0|15] "" XXX
 SG_ NEW_SIGNAL_14 : 181|2@0+ (1,0) [0|3] "" XXX
 SG_ NEW_SIGNAL_15 : 183|2@0+ (1,0) [0|3] "" XXX
 SG_ NEW_SIGNAL_16 : 185|2@0+ (1,0) [0|3] "" XXX
 SG_ NEW_SIGNAL_17 : 187|2@0+ (1,0) [0|3] "" XXX

BO_ 951 RADAR_TRACK_3b7: 24 RADAR
 SG_ CHECKSUM : 0|16@1+ (1,0) [0|65535] "" XXX
 SG_ COUNTER : 16|8@1+ (1,0) [0|255] "" XXX
 SG_ NEW_SIGNAL_1 : 25|2@0+ (1,0) [0|3] "" XXX
 SG_ NEW_SIGNAL_3 : 28|2@0+ (1,0) [0|3] "" XXX
 SG_ COUNTER_3 : 31|2@0+ (1,0) [0|3] "" XXX
 SG_ NEW_SIGNAL_2 : 38|7@0- (1,0) [0|127] "" XXX
 SG_ COUNTER_256 : 47|8@0+ (1,0) [0|255] "" XXX
 SG_ NEW_SIGNAL_6 : 51|4@0+ (1,0) [0|15] "" XXX
 SG_ STATE : 54|3@0+ (1,0) [0|7] "" XXX
 SG_ NEW_SIGNAL_8 : 62|7@0- (1,0) [0|127] "" XXX
 SG_ LONG_DIST : 63|12@1+ (0.05,0) [0|8191] "m" XXX
 SG_ LAT_DIST : 76|12@1- (0.05,0) [0|127] "" XXX
 SG_ REL_SPEED : 88|14@1- (0.01,0) [0|16383] "" XXX
 SG_ NEW_SIGNAL_4 : 103|2@0+ (1,0) [0|3] "" XXX
 SG_ LAT_DIST_ACCEL : 104|13@1- (1,0) [0|8191] "" XXX
 SG_ REL_ACCEL : 118|10@1- (0.02,0) [0|1023] "" XXX
 SG_ NEW_SIGNAL_18 : 129|2@0+ (1,0) [0|3] "" XXX
 SG_ NEW_SIGNAL_5 : 133|4@0+ (1,0) [0|15] "" XXX
 SG_ NEW_SIGNAL_10 : 138|5@1+ (1,0) [0|31] "" XXX
 SG_ NEW_SIGNAL_11 : 149|6@0+ (1,0) [0|63] "" XXX
 SG_ NEW_SIGNAL_7 : 152|10@1+ (1,0) [0|1023] "" XXX
 SG_ NEW_SIGNAL_9 : 162|9@1- (1,0) [0|511] "" XXX
 SG_ NEW_SIGNAL_13 : 175|4@0+ (1,0) [0|15] "" XXX
 SG_ NEW_SIGNAL_12 : 179|4@0+ (1,0) [0|15] "" XXX
 SG_ NEW_SIGNAL_14 : 181|2@0+ (1,0) [0|3] "" XXX
 SG_ NEW_SIGNAL_15 : 183|2@0+ (1,0) [0|3] "" XXX
 SG_ NEW_SIGNAL_16 : 185|2@0+ (1,0) [0|3] "" XXX
 SG_ NEW_SIGNAL_17 : 187|2@0+ (1,0) [0|3] "" XXX

BO_ 952 RADAR_TRACK_3b8: 24 RADAR
 SG_ CHECKSUM : 0|16@1+ (1,0) [0|65535] "" XXX
 SG_ COUNTER : 16|8@1+ (1,0) [0|255] "" XXX
 SG_ NEW_SIGNAL_1 : 25|2@0+ (1,0) [0|3] "" XXX
 SG_ NEW_SIGNAL_3 : 28|2@0+ (1,0) [0|3] "" XXX
 SG_ COUNTER_3 : 31|2@0+ (1,0) [0|3] "" XXX
 SG_ NEW_SIGNAL_2 : 38|7@0- (1,0) [0|127] "" XXX
 SG_ COUNTER_256 : 47|8@0+ (1,0) [0|255] "" XXX
 SG_ NEW_SIGNAL_6 : 51|4@0+ (1,0) [0|15] "" XXX
 SG_ STATE : 54|3@0+ (1,0) [0|7] "" XXX
 SG_ NEW_SIGNAL_8 : 62|7@0- (1,0) [0|127] "" XXX
 SG_ LONG_DIST : 63|12@1+ (0.05,0) [0|8191] "m" XXX
 SG_ LAT_DIST : 76|12@1- (0.05,0) [0|127] "" XXX
 SG_ REL_SPEED : 88|14@1- (0.01,0) [0|16383] "" XXX
 SG_ NEW_SIGNAL_4 : 103|2@0+ (1,0) [0|3] "" XXX
 SG_ LAT_DIST_ACCEL : 104|13@1- (1,0) [0|8191] "" XXX
 SG_ REL_ACCEL : 118|10@1- (0.02,0) [0|1023] "" XXX
 SG_ NEW_SIGNAL_18 : 129|2@0+ (1,0) [0|3] "" XXX
 SG_ NEW_SIGNAL_5 : 133|4@0+ (1,0) [0|15] "" XXX
 SG_ NEW_SIGNAL_10 : 138|5@1+ (1,0) [0|31] "" XXX
 SG_ NEW_SIGNAL_11 : 149|6@0+ (1,0) [0|63] "" XXX
 SG_ NEW_SIGNAL_7 : 152|10@1+ (1,0) [0|1023] "" XXX
 SG_ NEW_SIGNAL_9 : 162|9@1- (1,0) [0|511] "" XXX
 SG_ NEW_SIGNAL_13 : 175|4@0+ (1,0) [0|15] "" XXX
 SG_ NEW_SIGNAL_12 : 179|4@0+ (1,0) [0|15] "" XXX
 SG_ NEW_SIGNAL_14 : 181|2@0+ (1,0) [0|3] "" XXX
 SG_ NEW_SIGNAL_15 : 183|2@0+ (1,0) [0|3] "" XXX
 SG_ NEW_SIGNAL_16 : 185|2@0+ (1,0) [0|3] "" XXX
 SG_ NEW_SIGNAL_17 : 187|2@0+ (1,0) [0|3] "" XXX

BO_ 953 RADAR_TRACK_3b9: 24 RADAR
 SG_ CHECKSUM : 0|16@1+ (1,0) [0|65535] "" XXX
 SG_ COUNTER : 16|8@1+ (1,0) [0|255] "" XXX
 SG_ NEW_SIGNAL_1 : 25|2@0+ (1,0) [0|3] "" XXX
 SG_ NEW_SIGNAL_3 : 28|2@0+ (1,0) [0|3] "" XXX
 SG_ COUNTER_3 : 31|2@0+ (1,0) [0|3] "" XXX
 SG_ NEW_SIGNAL_2 : 38|7@0- (1,0) [0|127] "" XXX
 SG_ COUNTER_256 : 47|8@0+ (1,0) [0|255] "" XXX
 SG_ NEW_SIGNAL_6 : 51|4@0+ (1,0) [0|15] "" XXX
 SG_ STATE : 54|3@0+ (1,0) [0|7] "" XXX
 SG_ NEW_SIGNAL_8 : 62|7@0- (1,0) [0|127] "" XXX
 SG_ LONG_DIST : 63|12@1+ (0.05,0) [0|8191] "m" XXX
 SG_ LAT_DIST : 76|12@1- (0.05,0) [0|127] "" XXX
 SG_ REL_SPEED : 88|14@1- (0.01,0) [0|16383] "" XXX
 SG_ NEW_SIGNAL_4 : 103|2@0+ (1,0) [0|3] "" XXX
 SG_ LAT_DIST_ACCEL : 104|13@1- (1,0) [0|8191] "" XXX
 SG_ REL_ACCEL : 118|10@1- (0.02,0) [0|1023] "" XXX
 SG_ NEW_SIGNAL_18 : 129|2@0+ (1,0) [0|3] "" XXX
 SG_ NEW_SIGNAL_5 : 133|4@0+ (1,0) [0|15] "" XXX
 SG_ NEW_SIGNAL_10 : 138|5@1+ (1,0) [0|31] "" XXX
 SG_ NEW_SIGNAL_11 : 149|6@0+ (1,0) [0|63] "" XXX
 SG_ NEW_SIGNAL_7 : 152|10@1+ (1,0) [0|1023] "" XXX
 SG_ NEW_SIGNAL_9 : 162|9@1- (1,0) [0|511] "" XXX
 SG_ NEW_SIGNAL_13 : 175|4@0+ (1,0) [0|15] "" XXX
 SG_ NEW_SIGNAL_12 : 179|4@0+ (1,0) [0|15] "" XXX
 SG_ NEW_SIGNAL_14 : 181|2@0+ (1,0) [0|3] "" XXX
 SG_ NEW_SIGNAL_15 : 183|2@0+ (1,0) [0|3] "" XXX
 SG_ NEW_SIGNAL_16 : 185|2@0+ (1,0) [0|3] "" XXX
 SG_ NEW_SIGNAL_17 : 187|2@0+ (1,0) [0|3] "" XXX

BO_ 954 RADAR_TRACK_3ba: 24 RADAR
 SG_ CHECKSUM : 0|16@1+ (1,0) [0|65535] "" XXX
 SG_ COUNTER : 16|8@1+ (1,0) [0|255] "" XXX
 SG_ NEW_SIGNAL_1 : 25|2@0+ (1,0) [0|3] "" XXX
 SG_ NEW_SIGNAL_3 : 28|2@0+ (1,0) [0|3] "" XXX
 SG_ COUNTER_3 : 31|2@0+ (1,0) [0|3] "" XXX
 SG_ NEW_SIGNAL_2 : 38|7@0- (1,0) [0|127] "" XXX
 SG_ COUNTER_256 : 47|8@0+ (1,0) [0|255] "" XXX
 SG_ NEW_SIGNAL_6 : 51|4@0+ (1,0) [0|15] "" XXX
 SG_ STATE : 54|3@0+ (1,0) [0|7] "" XXX
 SG_ NEW_SIGNAL_8 : 62|7@0- (1,0) [0|127] "" XXX
 SG_ LONG_DIST : 63|12@1+ (0.05,0) [0|8191] "m" XXX
 SG_ LAT_DIST : 76|12@1- (0.05,0) [0|127] "" XXX
 SG_ REL_SPEED : 88|14@1- (0.01,0) [0|16383] "" XXX
 SG_ NEW_SIGNAL_4 : 103|2@0+ (1,0) [0|3] "" XXX
 SG_ LAT_DIST_ACCEL : 104|13@1- (1,0) [0|8191] "" XXX
 SG_ REL_ACCEL : 118|10@1- (0.02,0) [0|1023] "" XXX
 SG_ NEW_SIGNAL_18 : 129|2@0+ (1,0) [0|3] "" XXX
 SG_ NEW_SIGNAL_5 : 133|4@0+ (1,0) [0|15] "" XXX
 SG_ NEW_SIGNAL_10 : 138|5@1+ (1,0) [0|31] "" XXX
 SG_ NEW_SIGNAL_11 : 149|6@0+ (1,0) [0|63] "" XXX
 SG_ NEW_SIGNAL_7 : 152|10@1+ (1,0) [0|1023] "" XXX
 SG_ NEW_SIGNAL_9 : 162|9@1- (1,0) [0|511] "" XXX
 SG_ NEW_SIGNAL_13 : 175|4@0+ (1,0) [0|15] "" XXX
 SG_ NEW_SIGNAL_12 : 179|4@0+ (1,0) [0|15] "" XXX
 SG_ NEW_SIGNAL_14 : 181|2@0+ (1,0) [0|3] "" XXX
 SG_ NEW_SIGNAL_15 : 183|2@0+ (1,0) [0|3] "" XXX
 SG_ NEW_SIGNAL_16 : 185|2@0+ (1,0) [0|3] "" XXX
 SG_ NEW_SIGNAL_17 : 187|2@0+ (1,0) [0|3] "" XXX

BO_ 955 RADAR_TRACK_3bb: 24 RADAR
 SG_ CHECKSUM : 0|16@1+ (1,0) [0|65535] "" XXX
 SG_ COUNTER : 16|8@1+ (1,0) [0|255] "" XXX
 SG_ NEW_SIGNAL_1 : 25|2@0+ (1,0) [0|3] "" XXX
 SG_ NEW_SIGNAL_3 : 28|2@0+ (1,0) [0|3] "" XXX
 SG_ COUNTER_3 : 31|2@0+ (1,0) [0|3] "" XXX
 SG_ NEW_SIGNAL_2 : 38|7@0- (1,0) [0|127] "" XXX
 SG_ COUNTER_256 : 47|8@0+ (1,0) [0|255] "" XXX
 SG_ NEW_SIGNAL_6 : 51|4@0+ (1,0) [0|15] "" XXX
 SG_ STATE : 54|3@0+ (1,0) [0|7] "" XXX
 SG_ NEW_SIGNAL_8 : 62|7@0- (1,0) [0|127] "" XXX
 SG_ LONG_DIST : 63|12@1+ (0.05,0) [0|8191] "m" XXX
 SG_ LAT_DIST : 76|12@1- (0.05,0) [0|127] "" XXX
 SG_ REL_SPEED : 88|14@1- (0.01,0) [0|16383] "" XXX
 SG_ NEW_SIGNAL_4 : 103|2@0+ (1,0) [0|3] "" XXX
 SG_ LAT_DIST_ACCEL : 104|13@1- (1,0) [0|8191] "" XXX
 SG_ REL_ACCEL : 118|10@1- (0.02,0) [0|1023] "" XXX
 SG_ NEW_SIGNAL_18 : 129|2@0+ (1,0) [0|3] "" XXX
 SG_ NEW_SIGNAL_5 : 133|4@0+ (1,0) [0|15] "" XXX
 SG_ NEW_SIGNAL_10 : 138|5@1+ (1,0) [0|31] "" XXX
 SG_ NEW_SIGNAL_11 : 149|6@0+ (1,0) [0|63] "" XXX
 SG_ NEW_SIGNAL_7 : 152|10@1+ (1,0) [0|1023] "" XXX
 SG_ NEW_SIGNAL_9 : 162|9@1- (1,0) [0|511] "" XXX
 SG_ NEW_SIGNAL_13 : 175|4@0+ (1,0) [0|15] "" XXX
 SG_ NEW_SIGNAL_12 : 179|4@0+ (1,0) [0|15] "" XXX
 SG_ NEW_SIGNAL_14 : 181|2@0+ (1,0) [0|3] "" XXX
 SG_ NEW_SIGNAL_15 : 183|2@0+ (1,0) [0|3] "" XXX
 SG_ NEW_SIGNAL_16 : 185|2@0+ (1,0) [0|3] "" XXX
 SG_ NEW_SIGNAL_17 : 187|2@0+ (1,0) [0|3] "" XXX

BO_ 956 RADAR_TRACK_3bc: 24 RADAR
 SG_ CHECKSUM : 0|16@1+ (1,0) [0|65535] "" XXX
 SG_ COUNTER : 16|8@1+ (1,0) [0|255] "" XXX
 SG_ NEW_SIGNAL_1 : 25|2@0+ (1,0) [0|3] "" XXX
 SG_ NEW_SIGNAL_3 : 28|2@0+ (1,0) [0|3] "" XXX
 SG_ COUNTER_3 : 31|2@0+ (1,0) [0|3] "" XXX
 SG_ NEW_SIGNAL_2 : 38|7@0- (1,0) [0|127] "" XXX
 SG_ COUNTER_256 : 47|8@0+ (1,0) [0|255] "" XXX
 SG_ NEW_SIGNAL_6 : 51|4@0+ (1,0) [0|15] "" XXX
 SG_ STATE : 54|3@0+ (1,0) [0|7] "" XXX
 SG_ NEW_SIGNAL_8 : 62|7@0- (1,0) [0|127] "" XXX
 SG_ LONG_DIST : 63|12@1+ (0.05,0) [0|8191] "m" XXX
 SG_ LAT_DIST : 76|12@1- (0.05,0) [0|127] "" XXX
 SG_ REL_SPEED : 88|14@1- (0.01,0) [0|16383] "" XXX
 SG_ NEW_SIGNAL_4 : 103|2@0+ (1,0) [0|3] "" XXX
 SG_ LAT_DIST_ACCEL : 104|13@1- (1,0) [0|8191] "" XXX
 SG_ REL_ACCEL : 118|10@1- (0.02,0) [0|1023] "" XXX
 SG_ NEW_SIGNAL_18 : 129|2@0+ (1,0) [0|3] "" XXX
 SG_ NEW_SIGNAL_5 : 133|4@0+ (1,0) [0|15] "" XXX
 SG_ NEW_SIGNAL_10 : 138|5@1+ (1,0) [0|31] "" XXX
 SG_ NEW_SIGNAL_11 : 149|6@0+ (1,0) [0|63] "" XXX
 SG_ NEW_SIGNAL_7 : 152|10@1+ (1,0) [0|1023] "" XXX
 SG_ NEW_SIGNAL_9 : 162|9@1- (1,0) [0|511] "" XXX
 SG_ NEW_SIGNAL_13 : 175|4@0+ (1,0) [0|15] "" XXX
 SG_ NEW_SIGNAL_12 : 179|4@0+ (1,0) [0|15] "" XXX
 SG_ NEW_SIGNAL_14 : 181|2@0+ (1,0) [0|3] "" XXX
 SG_ NEW_SIGNAL_15 : 183|2@0+ (1,0) [0|3] "" XXX
 SG_ NEW_SIGNAL_16 : 185|2@0+ (1,0) [0|3] "" XXX
 SG_ NEW_SIGNAL_17 : 187|2@0+ (1,0) [0|3] "" XXX

BO_ 957 RADAR_TRACK_3bd: 24 RADAR
 SG_ CHECKSUM : 0|16@1+ (1,0) [0|65535] "" XXX
 SG_ COUNTER : 16|8@1+ (1,0) [0|255] "" XXX
 SG_ NEW_SIGNAL_1 : 25|2@0+ (1,0) [0|3] "" XXX
 SG_ NEW_SIGNAL_3 : 28|2@0+ (1,0) [0|3] "" XXX
 SG_ COUNTER_3 : 31|2@0+ (1,0) [0|3] "" XXX
 SG_ NEW_SIGNAL_2 : 38|7@0- (1,0) [0|127] "" XXX
 SG_ COUNTER_256 : 47|8@0+ (1,0) [0|255] "" XXX
 SG_ NEW_SIGNAL_6 : 51|4@0+ (1,0) [0|15] "" XXX
 SG_ STATE : 54|3@0+ (1,0) [0|7] "" XXX
 SG_ NEW_SIGNAL_8 : 62|7@0- (1,0) [0|127] "" XXX
 SG_ LONG_DIST : 63|12@1+ (0.05,0) [0|8191] "m" XXX
 SG_ LAT_DIST : 76|12@1- (0.05,0) [0|127] "" XXX
 SG_ REL_SPEED : 88|14@1- (0.01,0) [0|16383] "" XXX
 SG_ NEW_SIGNAL_4 : 103|2@0+ (1,0) [0|3] "" XXX
 SG_ LAT_DIST_ACCEL : 104|13@1- (1,0) [0|8191] "" XXX
 SG_ REL_ACCEL : 118|10@1- (0.02,0) [0|1023] "" XXX
 SG_ NEW_SIGNAL_18 : 129|2@0+ (1,0) [0|3] "" XXX
 SG_ NEW_SIGNAL_5 : 133|4@0+ (1,0) [0|15] "" XXX
 SG_ NEW_SIGNAL_10 : 138|5@1+ (1,0) [0|31] "" XXX
 SG_ NEW_SIGNAL_11 : 149|6@0+ (1,0) [0|63] "" XXX
 SG_ NEW_SIGNAL_7 : 152|10@1+ (1,0) [0|1023] "" XXX
 SG_ NEW_SIGNAL_9 : 162|9@1- (1,0) [0|511] "" XXX
 SG_ NEW_SIGNAL_13 : 175|4@0+ (1,0) [0|15] "" XXX
 SG_ NEW_SIGNAL_12 : 179|4@0+ (1,0) [0|15] "" XXX
 SG_ NEW_SIGNAL_14 : 181|2@0+ (1,0) [0|3] "" XXX
 SG_ NEW_SIGNAL_15 : 183|2@0+ (1,0) [0|3] "" XXX
 SG_ NEW_SIGNAL_16 : 185|2@0+ (1,0) [0|3] "" XXX
 SG_ NEW_SIGNAL_17 : 187|2@0+ (1,0) [0|3] "" XXX

BO_ 958 RADAR_TRACK_3be: 24 RADAR
 SG_ CHECKSUM : 0|16@1+ (1,0) [0|65535] "" XXX
 SG_ COUNTER : 16|8@1+ (1,0) [0|255] "" XXX
 SG_ NEW_SIGNAL_1 : 25|2@0+ (1,0) [0|3] "" XXX
 SG_ NEW_SIGNAL_3 : 28|2@0+ (1,0) [0|3] "" XXX
 SG_ COUNTER_3 : 31|2@0+ (1,0) [0|3] "" XXX
 SG_ NEW_SIGNAL_2 : 38|7@0- (1,0) [0|127] "" XXX
 SG_ COUNTER_256 : 47|8@0+ (1,0) [0|255] "" XXX
 SG_ NEW_SIGNAL_6 : 51|4@0+ (1,0) [0|15] "" XXX
 SG_ STATE : 54|3@0+ (1,0) [0|7] "" XXX
 SG_ NEW_SIGNAL_8 : 62|7@0- (1,0) [0|127] "" XXX
 SG_ LONG_DIST : 63|12@1+ (0.05,0) [0|8191] "m" XXX
 SG_ LAT_DIST : 76|12@1- (0.05,0) [0|127] "" XXX
 SG_ REL_SPEED : 88|14@1- (0.01,0) [0|16383] "" XXX
 SG_ NEW_SIGNAL_4 : 103|2@0+ (1,0) [0|3] "" XXX
 SG_ LAT_DIST_ACCEL : 104|13@1- (1,0) [0|8191] "" XXX
 SG_ REL_ACCEL : 118|10@1- (0.02,0) [0|1023] "" XXX
 SG_ NEW_SIGNAL_18 : 129|2@0+ (1,0) [0|3] "" XXX
 SG_ NEW_SIGNAL_5 : 133|4@0+ (1,0) [0|15] "" XXX
 SG_ NEW_SIGNAL_10 : 138|5@1+ (1,0) [0|31] "" XXX
 SG_ NEW_SIGNAL_11 : 149|6@0+ (1,0) [0|63] "" XXX
 SG_ NEW_SIGNAL_7 : 152|10@1+ (1,0) [0|1023] "" XXX
 SG_ NEW_SIGNAL_9 : 162|9@1- (1,0) [0|511] "" XXX
 SG_ NEW_SIGNAL_13 : 175|4@0+ (1,0) [0|15] "" XXX
 SG_ NEW_SIGNAL_12 : 179|4@0+ (1,0) [0|15] "" XXX
 SG_ NEW_SIGNAL_14 : 181|2@0+ (1,0) [0|3] "" XXX
 SG_ NEW_SIGNAL_15 : 183|2@0+ (1,0) [0|3] "" XXX
 SG_ NEW_SIGNAL_16 : 185|2@0+ (1,0) [0|3] "" XXX
 SG_ NEW_SIGNAL_17 : 187|2@0+ (1,0) [0|3] "" XXX

BO_ 959 RADAR_TRACK_3bf: 24 RADAR
 SG_ CHECKSUM : 0|16@1+ (1,0) [0|65535] "" XXX
 SG_ COUNTER : 16|8@1+ (1,0) [0|255] "" XXX
 SG_ NEW_SIGNAL_1 : 25|2@0+ (1,0) [0|3] "" XXX
 SG_ NEW_SIGNAL_3 : 28|2@0+ (1,0) [0|3] "" XXX
 SG_ COUNTER_3 : 31|2@0+ (1,0) [0|3] "" XXX
 SG_ NEW_SIGNAL_2 : 38|7@0- (1,0) [0|127] "" XXX
 SG_ COUNTER_256 : 47|8@0+ (1,0) [0|255] "" XXX
 SG_ NEW_SIGNAL_6 : 51|4@0+ (1,0) [0|15] "" XXX
 SG_ STATE : 54|3@0+ (1,0) [0|7] "" XXX
 SG_ NEW_SIGNAL_8 : 62|7@0- (1,0) [0|127] "" XXX
 SG_ LONG_DIST : 63|12@1+ (0.05,0) [0|8191] "m" XXX
 SG_ LAT_DIST : 76|12@1- (0.05,0) [0|127] "" XXX
 SG_ REL_SPEED : 88|14@1- (0.01,0) [0|16383] "" XXX
 SG_ NEW_SIGNAL_4 : 103|2@0+ (1,0) [0|3] "" XXX
 SG_ LAT_DIST_ACCEL : 104|13@1- (1,0) [0|8191] "" XXX
 SG_ REL_ACCEL : 118|10@1- (0.02,0) [0|1023] "" XXX
 SG_ NEW_SIGNAL_18 : 129|2@0+ (1,0) [0|3] "" XXX
 SG_ NEW_SIGNAL_5 : 133|4@0+ (1,0) [0|15] "" XXX
 SG_ NEW_SIGNAL_10 : 138|5@1+ (1,0) [0|31] "" XXX
 SG_ NEW_SIGNAL_11 : 149|6@0+ (1,0) [0|63] "" XXX
 SG_ NEW_SIGNAL_7 : 152|10@1+ (1,0) [0|1023] "" XXX
 SG_ NEW_SIGNAL_9 : 162|9@1- (1,0) [0|511] "" XXX
 SG_ NEW_SIGNAL_13 : 175|4@0+ (1,0) [0|15] "" XXX
 SG_ NEW_SIGNAL_12 : 179|4@0+ (1,0) [0|15] "" XXX
 SG_ NEW_SIGNAL_14 : 181|2@0+ (1,0) [0|3] "" XXX
 SG_ NEW_SIGNAL_15 : 183|2@0+ (1,0) [0|3] "" XXX
 SG_ NEW_SIGNAL_16 : 185|2@0+ (1,0) [0|3] "" XXX
 SG_ NEW_SIGNAL_17 : 187|2@0+ (1,0) [0|3] "" XXX

BO_ 960 RADAR_TRACK_3c0: 24 RADAR
 SG_ CHECKSUM : 0|16@1+ (1,0) [0|65535] "" XXX
 SG_ COUNTER : 16|8@1+ (1,0) [0|255] "" XXX
 SG_ NEW_SIGNAL_1 : 25|2@0+ (1,0) [0|3] "" XXX
 SG_ NEW_SIGNAL_3 : 28|2@0+ (1,0) [0|3] "" XXX
 SG_ COUNTER_3 : 31|2@0+ (1,0) [0|3] "" XXX
 SG_ NEW_SIGNAL_2 : 38|7@0- (1,0) [0|127] "" XXX
 SG_ COUNTER_256 : 47|8@0+ (1,0) [0|255] "" XXX
 SG_ NEW_SIGNAL_6 : 51|4@0+ (1,0) [0|15] "" XXX
 SG_ STATE : 54|3@0+ (1,0) [0|7] "" XXX
 SG_ NEW_SIGNAL_8 : 62|7@0- (1,0) [0|127] "" XXX
 SG_ LONG_DIST : 63|12@1+ (0.05,0) [0|8191] "m" XXX
 SG_ LAT_DIST : 76|12@1- (0.05,0) [0|127] "" XXX
 SG_ REL_SPEED : 88|14@1- (0.01,0) [0|16383] "" XXX
 SG_ NEW_SIGNAL_4 : 103|2@0+ (1,0) [0|3] "" XXX
 SG_ LAT_DIST_ACCEL : 104|13@1- (1,0) [0|8191] "" XXX
 SG_ REL_ACCEL : 118|10@1- (0.02,0) [0|1023] "" XXX
 SG_ NEW_SIGNAL_18 : 129|2@0+ (1,0) [0|3] "" XXX
 SG_ NEW_SIGNAL_5 : 133|4@0+ (1,0) [0|15] "" XXX
 SG_ NEW_SIGNAL_10 : 138|5@1+ (1,0) [0|31] "" XXX
 SG_ NEW_SIGNAL_11 : 149|6@0+ (1,0) [0|63] "" XXX
 SG_ NEW_SIGNAL_7 : 152|10@1+ (1,0) [0|1023] "" XXX
 SG_ NEW_SIGNAL_9 : 162|9@1- (1,0) [0|511] "" XXX
 SG_ NEW_SIGNAL_13 : 175|4@0+ (1,0) [0|15] "" XXX
 SG_ NEW_SIGNAL_12 : 179|4@0+ (1,0) [0|15] "" XXX
 SG_ NEW_SIGNAL_14 : 181|2@0+ (1,0) [0|3] "" XXX
 SG_ NEW_SIGNAL_15 : 183|2@0+ (1,0) [0|3] "" XXX
 SG_ NEW_SIGNAL_16 : 185|2@0+ (1,0) [0|3] "" XXX
 SG_ NEW_SIGNAL_17 : 187|2@0+ (1,0) [0|3] "" XXX

BO_ 961 RADAR_TRACK_3c1: 24 RADAR
 SG_ CHECKSUM : 0|16@1+ (1,0) [0|65535] "" XXX
 SG_ COUNTER : 16|8@1+ (1,0) [0|255] "" XXX
 SG_ NEW_SIGNAL_1 : 25|2@0+ (1,0) [0|3] "" XXX
 SG_ NEW_SIGNAL_3 : 28|2@0+ (1,0) [0|3] "" XXX
 SG_ COUNTER_3 : 31|2@0+ (1,0) [0|3] "" XXX
 SG_ NEW_SIGNAL_2 : 38|7@0- (1,0) [0|127] "" XXX
 SG_ COUNTER_256 : 47|8@0+ (1,0) [0|255] "" XXX
 SG_ NEW_SIGNAL_6 : 51|4@0+ (1,0) [0|15] "" XXX
 SG_ STATE : 54|3@0+ (1,0) [0|7] "" XXX
 SG_ NEW_SIGNAL_8 : 62|7@0- (1,0) [0|127] "" XXX
 SG_ LONG_DIST : 63|12@1+ (0.05,0) [0|8191] "m" XXX
 SG_ LAT_DIST : 76|12@1- (0.05,0) [0|127] "" XXX
 SG_ REL_SPEED : 88|14@1- (0.01,0) [0|16383] "" XXX
 SG_ NEW_SIGNAL_4 : 103|2@0+ (1,0) [0|3] "" XXX
 SG_ LAT_DIST_ACCEL : 104|13@1- (1,0) [0|8191] "" XXX
 SG_ REL_ACCEL : 118|10@1- (0.02,0) [0|1023] "" XXX
 SG_ NEW_SIGNAL_18 : 129|2@0+ (1,0) [0|3] "" XXX
 SG_ NEW_SIGNAL_5 : 133|4@0+ (1,0) [0|15] "" XXX
 SG_ NEW_SIGNAL_10 : 138|5@1+ (1,0) [0|31] "" XXX
 SG_ NEW_SIGNAL_11 : 149|6@0+ (1,0) [0|63] "" XXX
 SG_ NEW_SIGNAL_7 : 152|10@1+ (1,0) [0|1023] "" XXX
 SG_ NEW_SIGNAL_9 : 162|9@1- (1,0) [0|511] "" XXX
 SG_ NEW_SIGNAL_13 : 175|4@0+ (1,0) [0|15] "" XXX
 SG_ NEW_SIGNAL_12 : 179|4@0+ (1,0) [0|15] "" XXX
 SG_ NEW_SIGNAL_14 : 181|2@0+ (1,0) [0|3] "" XXX
 SG_ NEW_SIGNAL_15 : 183|2@0+ (1,0) [0|3] "" XXX
 SG_ NEW_SIGNAL_16 : 185|2@0+ (1,0) [0|3] "" XXX
 SG_ NEW_SIGNAL_17 : 187|2@0+ (1,0) [0|3] "" XXX

BO_ 962 RADAR_TRACK_3c2: 24 RADAR
 SG_ CHECKSUM : 0|16@1+ (1,0) [0|65535] "" XXX
 SG_ COUNTER : 16|8@1+ (1,0) [0|255] "" XXX
 SG_ NEW_SIGNAL_1 : 25|2@0+ (1,0) [0|3] "" XXX
 SG_ NEW_SIGNAL_3 : 28|2@0+ (1,0) [0|3] "" XXX
 SG_ COUNTER_3 : 31|2@0+ (1,0) [0|3] "" XXX
 SG_ NEW_SIGNAL_2 : 38|7@0- (1,0) [0|127] "" XXX
 SG_ COUNTER_256 : 47|8@0+ (1,0) [0|255] "" XXX
 SG_ NEW_SIGNAL_6 : 51|4@0+ (1,0) [0|15] "" XXX
 SG_ STATE : 54|3@0+ (1,0) [0|7] "" XXX
 SG_ NEW_SIGNAL_8 : 62|7@0- (1,0) [0|127] "" XXX
 SG_ LONG_DIST : 63|12@1+ (0.05,0) [0|8191] "m" XXX
 SG_ LAT_DIST : 76|12@1- (0.05,0) [0|127] "" XXX
 SG_ REL_SPEED : 88|14@1- (0.01,0) [0|16383] "" XXX
 SG_ NEW_SIGNAL_4 : 103|2@0+ (1,0) [0|3] "" XXX
 SG_ LAT_DIST_ACCEL : 104|13@1- (1,0) [0|8191] "" XXX
 SG_ REL_ACCEL : 118|10@1- (0.02,0) [0|1023] "" XXX
 SG_ NEW_SIGNAL_18 : 129|2@0+ (1,0) [0|3] "" XXX
 SG_ NEW_SIGNAL_5 : 133|4@0+ (1,0) [0|15] "" XXX
 SG_ NEW_SIGNAL_10 : 138|5@1+ (1,0) [0|31] "" XXX
 SG_ NEW_SIGNAL_11 : 149|6@0+ (1,0) [0|63] "" XXX
 SG_ NEW_SIGNAL_7 : 152|10@1+ (1,0) [0|1023] "" XXX
 SG_ NEW_SIGNAL_9 : 162|9@1- (1,0) [0|511] "" XXX
 SG_ NEW_SIGNAL_13 : 175|4@0+ (1,0) [0|15] "" XXX
 SG_ NEW_SIGNAL_12 : 179|4@0+ (1,0) [0|15] "" XXX
 SG_ NEW_SIGNAL_14 : 181|2@0+ (1,0) [0|3] "" XXX
 SG_ NEW_SIGNAL_15 : 183|2@0+ (1,0) [0|3] "" XXX
 SG_ NEW_SIGNAL_16 : 185|2@0+ (1,0) [0|3] "" XXX
 SG_ NEW_SIGNAL_17 : 187|2@0+ (1,0) [0|3] "" XXX

BO_ 963 RADAR_TRACK_3c3: 24 RADAR
 SG_ CHECKSUM : 0|16@1+ (1,0) [0|65535] "" XXX
 SG_ COUNTER : 16|8@1+ (1,0) [0|255] "" XXX
 SG_ NEW_SIGNAL_1 : 25|2@0+ (1,0) [0|3] "" XXX
 SG_ NEW_SIGNAL_3 : 28|2@0+ (1,0) [0|3] "" XXX
 SG_ COUNTER_3 : 31|2@0+ (1,0) [0|3] "" XXX
 SG_ NEW_SIGNAL_2 : 38|7@0- (1,0) [0|127] "" XXX
 SG_ COUNTER_256 : 47|8@0+ (1,0) [0|255] "" XXX
 SG_ NEW_SIGNAL_6 : 51|4@0+ (1,0) [0|15] "" XXX
 SG_ STATE : 54|3@0+ (1,0) [0|7] "" XXX
 SG_ NEW_SIGNAL_8 : 62|7@0- (1,0) [0|127] "" XXX
 SG_ LONG_DIST : 63|12@1+ (0.05,0) [0|8191] "m" XXX
 SG_ LAT_DIST : 76|12@1- (0.05,0) [0|127] "" XXX
 SG_ REL_SPEED : 88|14@1- (0.01,0) [0|16383] "" XXX
 SG_ NEW_SIGNAL_4 : 103|2@0+ (1,0) [0|3] "" XXX
 SG_ LAT_DIST_ACCEL : 104|13@1- (1,0) [0|8191] "" XXX
 SG_ REL_ACCEL : 118|10@1- (0.02,0) [0|1023] "" XXX
 SG_ NEW_SIGNAL_18 : 129|2@0+ (1,0) [0|3] "" XXX
 SG_ NEW_SIGNAL_5 : 133|4@0+ (1,0) [0|15] "" XXX
 SG_ NEW_SIGNAL_10 : 138|5@1+ (1,0) [0|31] "" XXX
 SG_ NEW_SIGNAL_11 : 149|6@0+ (1,0) [0|63] "" XXX
 SG_ NEW_SIGNAL_7 : 152|10@1+ (1,0) [0|1023] "" XXX
 SG_ NEW_SIGNAL_9 : 162|9@1- (1,0) [0|511] "" XXX
 SG_ NEW_SIGNAL_13 : 175|4@0+ (1,0) [0|15] "" XXX
 SG_ NEW_SIGNAL_12 : 179|4@0+ (1,0) [0|15] "" XXX
 SG_ NEW_SIGNAL_14 : 181|2@0+ (1,0) [0|3] "" XXX
 SG_ NEW_SIGNAL_15 : 183|2@0+ (1,0) [0|3] "" XXX
 SG_ NEW_SIGNAL_16 : 185|2@0+ (1,0) [0|3] "" XXX
 SG_ NEW_SIGNAL_17 : 187|2@0+ (1,0) [0|3] "" XXX

BO_ 964 RADAR_TRACK_3c4: 24 RADAR
 SG_ CHECKSUM : 0|16@1+ (1,0) [0|65535] "" XXX
 SG_ COUNTER : 16|8@1+ (1,0) [0|255] "" XXX
 SG_ NEW_SIGNAL_1 : 25|2@0+ (1,0) [0|3] "" XXX
 SG_ NEW_SIGNAL_3 : 28|2@0+ (1,0) [0|3] "" XXX
 SG_ COUNTER_3 : 31|2@0+ (1,0) [0|3] "" XXX
 SG_ NEW_SIGNAL_2 : 38|7@0- (1,0) [0|127] "" XXX
 SG_ COUNTER_256 : 47|8@0+ (1,0) [0|255] "" XXX
 SG_ NEW_SIGNAL_6 : 51|4@0+ (1,0) [0|15] "" XXX
 SG_ STATE : 54|3@0+ (1,0) [0|7] "" XXX
 SG_ NEW_SIGNAL_8 : 62|7@0- (1,0) [0|127] "" XXX
 SG_ LONG_DIST : 63|12@1+ (0.05,0) [0|8191] "m" XXX
 SG_ LAT_DIST : 76|12@1- (0.05,0) [0|127] "" XXX
 SG_ REL_SPEED : 88|14@1- (0.01,0) [0|16383] "" XXX
 SG_ NEW_SIGNAL_4 : 103|2@0+ (1,0) [0|3] "" XXX
 SG_ LAT_DIST_ACCEL : 104|13@1- (1,0) [0|8191] "" XXX
 SG_ REL_ACCEL : 118|10@1- (0.02,0) [0|1023] "" XXX
 SG_ NEW_SIGNAL_18 : 129|2@0+ (1,0) [0|3] "" XXX
 SG_ NEW_SIGNAL_5 : 133|4@0+ (1,0) [0|15] "" XXX
 SG_ NEW_SIGNAL_10 : 138|5@1+ (1,0) [0|31] "" XXX
 SG_ NEW_SIGNAL_11 : 149|6@0+ (1,0) [0|63] "" XXX
 SG_ NEW_SIGNAL_7 : 152|10@1+ (1,0) [0|1023] "" XXX
 SG_ NEW_SIGNAL_9 : 162|9@1- (1,0) [0|511] "" XXX
 SG_ NEW_SIGNAL_13 : 175|4@0+ (1,0) [0|15] "" XXX
 SG_ NEW_SIGNAL_12 : 179|4@0+ (1,0) [0|15] "" XXX
 SG_ NEW_SIGNAL_14 : 181|2@0+ (1,0) [0|3] "" XXX
 SG_ NEW_SIGNAL_15 : 183|2@0+ (1,0) [0|3] "" XXX
 SG_ NEW_SIGNAL_16 : 185|2@0+ (1,0) [0|3] "" XXX
 SG_ NEW_SIGNAL_17 : 187|2@0+ (1,0) [0|3] "" XXX
